## main/Kconfig.projbuild
```kconfig
menu "ledrx Configuration"

config WIFI_SSID
    string "WiFi SSID"
    default "myssid"
    help
        SSID (network name) for the example to connect to.

config WIFI_PASSWORD
    string "WiFi Password"
    default "mypassword"
    help
        WiFi password (WPA or WPA2) for the example to use.

config BROKER_URL
    string "Broker URL"
    default "mqtt://iot.eclipse.org"
    help
        URL of the broker to connect to

config MQTT_USERNAME
    string "MQTT Username"
    default "admin"
    help
        MQTT username for the example to use.

config MQTT_PASSWORD
    string "MQTT Password"
    default "admin"
    help
        MQTT password for the example to use.

config OTA_TOPIC_ADVERTISE
    string "MQTT OTA Advertise Topic"
    default "home/ota/advertise"
    help
        MQTT topic on which OTA software versions will be advertised.

config LED_GPIO_A
    int "LED channel A GPIO number"
	range 0 39
	default 26
	help
		GPIO number (IOxx) attached to the first LED control wire.

config LED_GPIO_B
    int "LED channel B GPIO number"
	range 0 39
	default 27
	help
		GPIO number (IOxx) attached to the second LED control wire.

config LED_NUM_PIXELS
    int "Number of pixels"
	range 0 655365
	default 50
	help
		Number of RGB LED pixels.

config LED_FRAME_BUFFER_SIZE
    int "Frame buffer size"
	range 0 50
	default 8
	help
		Number of frames in the frame buffer.

config LED_TOPIC_STREAM
    string "MQTT LED data topic"
    default "home/ledrx/stream"
    help
        MQTT topic on which streaming LED data is sent.

endmenu
```
